// digit_classifier_2.h
//
// Thin wrapper around TensorFlow Lite for Microcontrollers that loads
// digit_model_int8.tflite once and classifies single glyph crops.
//
// Model I/O (confirmed from the .tflite):
//   input:  int8 [1, 24, 16, 1]   (H=24, W=16, grayscale)
//   output: int8 [1, 11]          (softmax over 11 classes)
//
// Class mapping: 0-9, '.'  -- in that index order. NO dash/minus class:
// the target LCD panel (Schneider PowerLogic PM5000-series meter) never
// displays a negative reading, so 'dash' was removed from the training
// dataset and the model was retrained at 11-way output. The mapping
// itself lives in digit_labels.h (generated by model_to_c_array.py) so
// there's exactly one place that can go stale, not two.
//
// Requires one of, in Arduino Library Manager:
//   "Chirale_TensorFlowLite"   (actively maintained ESP32 port), or
//   "Arduino_TensorFlowLite"   (older, also works)
//
// -----------------------------------------------------------------------
// WHAT CHANGED FROM THE PREVIOUS VERSION OF THIS FILE, AND WHY
// -----------------------------------------------------------------------
// 1. tflite::GetModel(g_digit_model) -> tflite::GetModel(g_digit_model_data)
//    model_to_c_array.py emits the array as g_digit_model_data /
//    g_digit_model_data_len. The old name wouldn't even compile against
//    the currently-generated header.
//
// 2. 12 classes (with '-') -> 11 classes (no '-'), read from
//    digit_labels.h's DIGIT_NUM_CLASSES / digitClassToChar() instead of a
//    second hand-copied char array.
//
// 3. THE IMPORTANT ONE: the resize step used to bilinear-resize the RAW
//    grayscale glyph crop straight from the camera (values 0-255,
//    letterboxed onto a white/255 background, then divided by 255) and
//    hand that continuous grayscale to the model. But the model was
//    trained on a strict BINARY mask: digit_dataset_utils.py Otsu-
//    thresholds every training crop, crops to the ink's own tight
//    bounding box, resizes THAT boolean mask, and re-thresholds the
//    result back to {0,1} on a ZERO-padded canvas. Those are two
//    different input distributions -- feeding the model raw grayscale
//    when it only ever saw binary masks during training/calibration
//    would silently produce poor predictions on real hardware even
//    though everything upstream (panel detection, blob finding, row
//    grouping) is working correctly. binarizeCropResize() below
//    reproduces the training-side preprocessing step for step.
// -----------------------------------------------------------------------
#pragma once

#include <Chirale_TensorFlowLite.h>
#include "tensorflow/lite/micro/micro_interpreter.h"
#include "tensorflow/lite/micro/micro_mutable_op_resolver.h"
#include "tensorflow/lite/micro/micro_log.h"
#include "tensorflow/lite/schema/schema_generated.h"
#include "digit_model_data.h"   // g_digit_model_data / g_digit_model_data_len
#include "digit_labels.h"       // DIGIT_NUM_CLASSES, digitClassToChar()

#define MODEL_IN_H   24
#define MODEL_IN_W   16

// Largest raw glyph crop (gw x gh, BEFORE resizing down to the model's
// 16x24 canvas) this classifier will binarize. CROP_PADDING=3 plus this
// LCD's actual digit size never gets remotely close to this -- it's a
// generous ceiling so a stray oversized blob fails loudly (classify()
// returns -1) instead of overflowing a static buffer.
#define MAX_GLYPH_W  64
#define MAX_GLYPH_H  64

class DigitClassifier {
 public:
  bool begin() {
    model_ = tflite::GetModel(g_digit_model_data);
    if (model_->version() != TFLITE_SCHEMA_VERSION) {
      return false;   // model file / TFLM library schema mismatch
    }

    // Ops this graph actually uses -- verified directly against the
    // converted .tflite with tf.lite.experimental.Analyzer. Shape/
    // StridedSlice/Pack come from the Flatten layer's dynamic reshape,
    // NOT from any augmentation layer (augmentation lives only in the
    // training-time tf.data pipeline and never reaches the exported
    // graph at all).
    static tflite::MicroMutableOpResolver<8> resolver;
    resolver.AddConv2D();
    resolver.AddMaxPool2D();
    resolver.AddShape();
    resolver.AddStridedSlice();
    resolver.AddPack();
    resolver.AddReshape();
    resolver.AddFullyConnected();
    resolver.AddSoftmax();

    static tflite::MicroInterpreter static_interpreter(
        model_, resolver, tensor_arena_, kArenaSize);
    interpreter_ = &static_interpreter;

    if (interpreter_->AllocateTensors() != kTfLiteOk) return false;

    input_  = interpreter_->input(0);
    output_ = interpreter_->output(0);

    // Sanity-check shape so a mismatched model fails loudly, not silently.
    if (input_->dims->size != 4 ||
        input_->dims->data[1] != MODEL_IN_H ||
        input_->dims->data[2] != MODEL_IN_W) {
      return false;
    }
    return true;
  }

  // Classifies a single glyph. `glyph` is a tightly-packed w*h grayscale
  // (0-255) buffer, arbitrary size, straight from the camera crop --
  // NOT pre-binarized by the caller (this function does that itself,
  // the same way digit_dataset_utils.py does for training images).
  // Returns the predicted class index (0 .. DIGIT_NUM_CLASSES-1), or -1
  // on failure. If `confidence` is non-null, it's filled with the
  // softmax probability (0.0-1.0) of the winning class.
  int classify(const uint8_t *glyph, int w, int h, float *confidence = nullptr) {
    if (!glyph || w <= 0 || h <= 0) return -1;
    if (w > MAX_GLYPH_W || h > MAX_GLYPH_H) return -1;

    static uint8_t resized[MODEL_IN_W * MODEL_IN_H];  // {0,1} canvas -- matches training exactly
    if (!binarizeCropResize(glyph, w, h, resized)) return -1;

    float in_scale      = input_->params.scale;
    int   in_zero_point = input_->params.zero_point;
    for (int i = 0; i < MODEL_IN_W * MODEL_IN_H; i++) {
      // resized[i] is already 0 or 1 -- this is a binary ink mask, the
      // same representation train_digit_model.py fed the model (NOT
      // grayscale/255; there is no continuous range here at all).
      float pixelFloat = (float)resized[i];
      int32_t q = (int32_t)lroundf(pixelFloat / in_scale) + in_zero_point;
      if (q < -128) q = -128;
      if (q > 127)  q = 127;
      input_->data.int8[i] = (int8_t)q;
    }

    if (interpreter_->Invoke() != kTfLiteOk) return -1;

    // Dequantize output, argmax over the classes.
    float out_scale      = output_->params.scale;
    int   out_zero_point = output_->params.zero_point;
    int   bestIdx = 0;
    float bestVal = -1e9f;
    for (int i = 0; i < DIGIT_NUM_CLASSES; i++) {
      float v = (output_->data.int8[i] - out_zero_point) * out_scale;
      if (v > bestVal) { bestVal = v; bestIdx = i; }
    }
    if (confidence) *confidence = bestVal;
    return bestIdx;
  }

  char classChar(int classIdx) {
    return digitClassToChar(classIdx);
  }

 private:
  // ---------------------------------------------------------------------
  // Mirrors digit_dataset_utils.py's binarize_and_resize_aspect() step
  // for step:
  //   1. Otsu-threshold this crop's own grayscale histogram -> ink mask
  //      (ink = pixels DARKER than the threshold, matching this LCD's
  //      dark-text-on-light-background).
  //   2. Crop to the ink's OWN tight bounding box (not the padded photo
  //      crop) so the aspect ratio used for resizing is the glyph's
  //      real shape, not shape+padding.
  //   3. Aspect-preserving resize into a MODEL_IN_W x MODEL_IN_H canvas,
  //      centered, ZERO-padded (background = 0 -- this is a binary ink
  //      mask, not a grayscale letterboxed photo, so the pad color must
  //      be "no ink", not "white").
  //   4. Threshold the resized values back to a strict {0,1} canvas
  //      (matches Python's `arr >= 0.5`).
  // ---------------------------------------------------------------------
  static bool binarizeCropResize(const uint8_t *src, int w, int h, uint8_t *dst) {
    // ---- Otsu threshold over this crop's own 256-bin histogram ----
    int hist[256] = {0};
    for (int i = 0; i < w * h; i++) hist[src[i]]++;
    int threshold = otsuThreshold(hist, w * h);

    // ---- binarize into a scratch mask + find the ink's tight bbox ----
    static uint8_t binMask[MAX_GLYPH_W * MAX_GLYPH_H];
    int x0 = w, y0 = h, x1 = -1, y1 = -1;
    for (int y = 0; y < h; y++) {
      for (int x = 0; x < w; x++) {
        bool ink = src[y * w + x] < threshold;
        binMask[y * w + x] = ink ? 1 : 0;
        if (ink) {
          if (x < x0) x0 = x;
          if (x > x1) x1 = x;
          if (y < y0) y0 = y;
          if (y > y1) y1 = y;
        }
      }
    }
    if (x1 < x0 || y1 < y0) {
      memset(dst, 0, MODEL_IN_W * MODEL_IN_H);  // no ink found -- blank canvas
      return true;
    }

    int cropW = x1 - x0 + 1;
    int cropH = y1 - y0 + 1;

    // ---- aspect-preserving resize of the {0,1} mask into the canvas ----
    float scale = min((float)MODEL_IN_W / cropW, (float)MODEL_IN_H / cropH);
    int newW = max(1, (int)lroundf(cropW * scale));
    int newH = max(1, (int)lroundf(cropH * scale));
    int offX = (MODEL_IN_W - newW) / 2;
    int offY = (MODEL_IN_H - newH) / 2;

    memset(dst, 0, MODEL_IN_W * MODEL_IN_H);   // zero background -- matches training canvas

    for (int y = 0; y < newH; y++) {
      float srcYf = (newH > 1) ? ((float)y * (cropH - 1) / (newH - 1)) : 0.0f;
      int y0i = (int)srcYf, y1i = min(cropH - 1, y0i + 1);
      float fy = srcYf - y0i;
      for (int x = 0; x < newW; x++) {
        float srcXf = (newW > 1) ? ((float)x * (cropW - 1) / (newW - 1)) : 0.0f;
        int x0i = (int)srcXf, x1i = min(cropW - 1, x0i + 1);
        float fx = srcXf - x0i;

        float v00 = binMask[(y0 + y0i) * w + (x0 + x0i)];
        float v01 = binMask[(y0 + y0i) * w + (x0 + x1i)];
        float v10 = binMask[(y0 + y1i) * w + (x0 + x0i)];
        float v11 = binMask[(y0 + y1i) * w + (x0 + x1i)];
        float top = v00 * (1 - fx) + v01 * fx;
        float bot = v10 * (1 - fx) + v11 * fx;
        float val = top * (1 - fy) + bot * fy;

        dst[(offY + y) * MODEL_IN_W + (offX + x)] = (val >= 0.5f) ? 1 : 0;  // re-threshold, matches Python
      }
    }
    return true;
  }

  // Classic Otsu's method over a 256-bin grayscale histogram (same
  // algorithm as digit_dataset_utils.py's _otsu_threshold, just over a
  // per-value histogram instead of a 256-way np.histogram binning --
  // equivalent since grayscale is already 0-255 integer-valued).
  static int otsuThreshold(const int *hist, int total) {
    long sumAll = 0;
    for (int t = 0; t < 256; t++) sumAll += (long)t * hist[t];

    long sumB = 0, wB = 0;
    float bestVar = -1.0f;
    int bestThresh = 128;
    for (int t = 0; t < 256; t++) {
      wB += hist[t];
      if (wB == 0) continue;
      long wF = total - wB;
      if (wF == 0) break;
      sumB += (long)t * hist[t];
      float mB = (float)sumB / wB;
      float mF = (float)(sumAll - sumB) / wF;
      float varBetween = (float)wB * wF * (mB - mF) * (mB - mF);
      if (varBetween > bestVar) { bestVar = varBetween; bestThresh = t + 1; }
    }
    return bestThresh;
  }

  static constexpr int kArenaSize = 20 * 1024;   // roomy margin over the ~3KB this graph needs
  uint8_t tensor_arena_[kArenaSize];

  const tflite::Model   *model_       = nullptr;
  tflite::MicroInterpreter *interpreter_ = nullptr;
  TfLiteTensor *input_  = nullptr;
  TfLiteTensor *output_ = nullptr;
};
